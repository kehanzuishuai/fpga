`timescale 1ns/1ps

/* GENERATED by tools/gen_piano_rom.py: case ROMs against array ROMs */

module tb_rom_equiv;

reg clk = 1'b0;
always #5 clk = ~clk;

integer errors = 0;
integer i;

reg  [14:0] a_piano_level_rom = 0;
wire [11:0] q_piano_level_rom;
wire [11:0] f_piano_level_rom;
piano_level_rom u_piano_level_rom (.clk(clk), .addr(a_piano_level_rom), .q(q_piano_level_rom));
piano_level_rom_fast v_piano_level_rom (.clk(clk), .addr(a_piano_level_rom), .q(f_piano_level_rom));

reg  [8:0] a_piano_ratio_rom = 0;
wire [19:0] q_piano_ratio_rom;
wire [19:0] f_piano_ratio_rom;
piano_ratio_rom u_piano_ratio_rom (.clk(clk), .addr(a_piano_ratio_rom), .q(q_piano_ratio_rom));
piano_ratio_rom_fast v_piano_ratio_rom (.clk(clk), .addr(a_piano_ratio_rom), .q(f_piano_ratio_rom));

reg  [6:0] a_piano_note_rom = 0;
wire [21:0] q_piano_note_rom;
wire [21:0] f_piano_note_rom;
piano_note_rom u_piano_note_rom (.clk(clk), .addr(a_piano_note_rom), .q(q_piano_note_rom));
piano_note_rom_fast v_piano_note_rom (.clk(clk), .addr(a_piano_note_rom), .q(f_piano_note_rom));

reg  [8:0] a_piano_sine_rom = 0;
wire [25:0] q_piano_sine_rom;
wire [25:0] f_piano_sine_rom;
piano_sine_rom u_piano_sine_rom (.clk(clk), .addr(a_piano_sine_rom), .q(q_piano_sine_rom));
piano_sine_rom_fast v_piano_sine_rom (.clk(clk), .addr(a_piano_sine_rom), .q(f_piano_sine_rom));

reg  [9:0] a_piano_exp_rom = 0;
wire [17:0] q_piano_exp_rom;
wire [17:0] f_piano_exp_rom;
piano_exp_rom u_piano_exp_rom (.clk(clk), .addr(a_piano_exp_rom), .q(q_piano_exp_rom));
piano_exp_rom_fast v_piano_exp_rom (.clk(clk), .addr(a_piano_exp_rom), .q(f_piano_exp_rom));

initial begin
    for (i = 0; i < 32768; i = i + 1) begin
        a_piano_level_rom = i;
        @(posedge clk); #1;
        if (q_piano_level_rom !== f_piano_level_rom) begin
            errors = errors + 1;
            if (errors < 10) $display("ERROR piano_level_rom[%0d]: case %h, array %h", i, q_piano_level_rom, f_piano_level_rom);
        end
    end
    $display("piano_level_rom: 32768 addresses compared");
    for (i = 0; i < 512; i = i + 1) begin
        a_piano_ratio_rom = i;
        @(posedge clk); #1;
        if (q_piano_ratio_rom !== f_piano_ratio_rom) begin
            errors = errors + 1;
            if (errors < 10) $display("ERROR piano_ratio_rom[%0d]: case %h, array %h", i, q_piano_ratio_rom, f_piano_ratio_rom);
        end
    end
    $display("piano_ratio_rom: 512 addresses compared");
    for (i = 0; i < 128; i = i + 1) begin
        a_piano_note_rom = i;
        @(posedge clk); #1;
        if (q_piano_note_rom !== f_piano_note_rom) begin
            errors = errors + 1;
            if (errors < 10) $display("ERROR piano_note_rom[%0d]: case %h, array %h", i, q_piano_note_rom, f_piano_note_rom);
        end
    end
    $display("piano_note_rom: 128 addresses compared");
    for (i = 0; i < 512; i = i + 1) begin
        a_piano_sine_rom = i;
        @(posedge clk); #1;
        if (q_piano_sine_rom !== f_piano_sine_rom) begin
            errors = errors + 1;
            if (errors < 10) $display("ERROR piano_sine_rom[%0d]: case %h, array %h", i, q_piano_sine_rom, f_piano_sine_rom);
        end
    end
    $display("piano_sine_rom: 512 addresses compared");
    for (i = 0; i < 1024; i = i + 1) begin
        a_piano_exp_rom = i;
        @(posedge clk); #1;
        if (q_piano_exp_rom !== f_piano_exp_rom) begin
            errors = errors + 1;
            if (errors < 10) $display("ERROR piano_exp_rom[%0d]: case %h, array %h", i, q_piano_exp_rom, f_piano_exp_rom);
        end
    end
    $display("piano_exp_rom: 1024 addresses compared");
    if (errors == 0) $display("PASS: ROM forms identical");
    else $display("FAIL: %0d differences", errors);
    $finish;
end

endmodule
